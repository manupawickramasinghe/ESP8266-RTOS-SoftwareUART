## components/softuart/Kconfig
```kconfig
menu "Software UART (softuart)"

config SOFTUART_MAX_UARTS
    int "Number of software UART ports"
    range 1 8
    default 2
    help
        How many independent software UART ports softuart_open() accepts
        (port numbers 0 to this value minus one). Each port uses about
        16 bytes of RAM plus its receive buffer.

choice SOFTUART_RX_BUFFER_SIZE_CHOICE
    prompt "Receive buffer size per port"
    default SOFTUART_RX_BUFFER_SIZE_64
    help
        Size of each port's receive ring buffer. One slot stays free, so a
        port holds up to this many bytes minus one. When the buffer is
        full, newly received bytes are dropped.

    config SOFTUART_RX_BUFFER_SIZE_16
        bool "16 bytes"
    config SOFTUART_RX_BUFFER_SIZE_32
        bool "32 bytes"
    config SOFTUART_RX_BUFFER_SIZE_64
        bool "64 bytes"
    config SOFTUART_RX_BUFFER_SIZE_128
        bool "128 bytes"
    config SOFTUART_RX_BUFFER_SIZE_256
        bool "256 bytes"
endchoice

config SOFTUART_RX_BUFFER_SIZE
    int
    default 16 if SOFTUART_RX_BUFFER_SIZE_16
    default 32 if SOFTUART_RX_BUFFER_SIZE_32
    default 64 if SOFTUART_RX_BUFFER_SIZE_64
    default 128 if SOFTUART_RX_BUFFER_SIZE_128
    default 256 if SOFTUART_RX_BUFFER_SIZE_256

config SOFTUART_TX_EXTRA_IDLE_BITS
    int "Extra idle time after each transmitted byte (bit times)"
    range 0 10
    default 0
    help
        Idle time added after the stop bit of every transmitted byte. 0
        sends frames back to back with one stop bit (standard 8N1). Use 1
        for receivers that expect two stop bits, or 5 to reproduce the
        fixed gap of earlier versions of this library.

config SOFTUART_TX_CRITICAL_SECTION
    bool "Disable interrupts while a byte is transmitted"
    default n
    help
        Keeps other interrupts (Wi-Fi, timers, other GPIOs) from stretching
        transmitted bits, at the cost of delaying them for up to one frame
        (about 1 ms at 9600 baud). Received bytes on other software UART
        ports cannot be sampled during that time either.

endmenu
```

## main/Kconfig.projbuild
```kconfig
menu "Software UART example"

config EXAMPLE_SOFTUART_RX_GPIO
    int "RX GPIO number"
    range 0 15
    default 4
    help
        GPIO that receives data (connect it to the other device's TX).
        GPIO16 cannot be used because it has no interrupt. Avoid GPIO1 and
        GPIO3 (console UART), GPIO6-11 (flash) and the boot-strapping pins
        GPIO0, GPIO2 and GPIO15. The default GPIO4 is D2 on NodeMCU boards.

config EXAMPLE_SOFTUART_TX_GPIO
    int "TX GPIO number"
    range 0 16
    default 5
    help
        GPIO that transmits data (connect it to the other device's RX).
        The default GPIO5 is D1 on NodeMCU boards.

config EXAMPLE_SOFTUART_BAUD_RATE
    int "Baud rate"
    range 300 115200
    default 9600
    help
        Line speed of the software UART. Lower rates tolerate interrupt
        latency better; 9600 baud is the best-tested rate.

config EXAMPLE_SOFTUART_INVERT
    bool "Inverted (idle-low) line logic"
    default n
    help
        Enable for devices whose serial line idles low (inverted TTL),
        for example behind a single-transistor level shifter.

endmenu
```
